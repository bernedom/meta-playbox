## conf/bblayers.conf.sample
```bitbake
LCONF_VERSION = "7"
 
BBPATH = "${TOPDIR}"
BBFILES ?= ""

BBLAYERS ?= " \
    ${HOME}/image-builder/poky-dunfell/meta \
    ${HOME}/image-builder/poky-dunfell/meta-poky \
    ${HOME}/image-builder/poky-dunfell/meta-openembedded/meta-oe \
    ${HOME}/image-builder/poky-dunfell/meta-openembedded/meta-multimedia \
    ${HOME}/image-builder/poky-dunfell/meta-openembedded/meta-networking \
    ${HOME}/image-builder/poky-dunfell/meta-openembedded/meta-filesystems \
    ${HOME}/image-builder/poky-dunfell/meta-openembedded/meta-perl \
    ${HOME}/image-builder/poky-dunfell/meta-openembedded/meta-python \
    ${HOME}/image-builder/poky-dunfell/meta-qt5 \
    ${HOME}/image-builder/poky-dunfell/meta-raspberrypi \
    ${HOME}/image-builder/poky-dunfell/meta-security \
    ${HOME}/image-builder/poky-dunfell/meta-virtualization \
    ${HOME}/image-builder/meta-playbox \
"
```

## conf/layer.conf
```bitbake
# We have a conf and classes directory, add to BBPATH
BBPATH .= ":${LAYERDIR}"

# We have recipes-* directories, add to BBFILES
BBFILES += "${LAYERDIR}/recipes-*/*/*.bb \
            ${LAYERDIR}/recipes-*/*/*.bbappend \
            ${LAYERDIR}/images/*.bb"

BBFILE_COLLECTIONS += "meta-playbox"
BBFILE_PATTERN_meta-playbox = "^${LAYERDIR}/"
BBFILE_PRIORITY_meta-playbox = "6"

LAYERDEPENDS_meta-playbox = "core"
LAYERSERIES_COMPAT_meta-playbox = "dunfell"
```
